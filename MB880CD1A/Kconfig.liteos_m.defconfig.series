## MB880CD1A/Kconfig.liteos_m.defconfig.series
```kconfig
# Copyright (c) 2025 INGCHIPS.
# Licensed under the Apache License, Version 2.0 (the "License");
# you may not use this file except in compliance with the License.
# You may obtain a copy of the License at
#
#     http://www.apache.org/licenses/LICENSE-2.0
#
# Unless required by applicable law or agreed to in writing, software
# distributed under the License is distributed on an "AS IS" BASIS,
# WITHOUT WARRANTIES OR CONDITIONS OF ANY KIND, either express or implied.
# See the License for the specific language governing permissions and
# limitations under the License.

if SOC_SERIES_ING9187

rsource "Kconfig.liteos_m.defconfig.ing9187"

config SOC_SERIES
    string
    default "ing9187
    
config NUM_IRQS
    int
    default 45

config SYS_CLOCK_HW_CYCLES_PER_SEC
    int
    default 64000000

endif
```

## ing916/Kconfig.liteos_m.defconfig.board
```kconfig
# Copyright (c) 2021 GOODIX.
# Licensed under the Apache License, Version 2.0 (the "License");
# you may not use this file except in compliance with the License.
# You may obtain a copy of the License at
#
#     http://www.apache.org/licenses/LICENSE-2.0
#
# Unless required by applicable law or agreed to in writing, software
# distributed under the License is distributed on an "AS IS" BASIS,
# WITHOUT WARRANTIES OR CONDITIONS OF ANY KIND, either express or implied.
# See the License for the specific language governing permissions and
# limitations under the License.

if BOARD_ING916

config GLOBAL_ING916_BOARD
        bool "Enable global macro"
        default y
        help
          This option allows you to enable a global macro in the build.

endif #BOARD_ING916
```
